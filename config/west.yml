## config/west.yml
```yaml
---
manifest:
  defaults:
    remote: urob

  remotes:
    - name: zmkfirmware
      url-base: https://github.com/zmkfirmware
    - name: urob
      url-base: https://github.com/urob

  projects:
    - name: zmk-helpers
      remote: urob
      revision: main 
    - name: zmk-auto-layer
      revision: main
      path: modules/auto-layer
    - name: zmk-tri-state
      revision: main
      path: modules/tri-state

    # ZMK with Zephyr namespaced under /zmk. This requires that ZMK imports
    # Zephyr with a path other than `zephyr` (as in `going-modular`).
    - name: zmk
      remote: zmkfirmware
      revision: main
      import: app/west.yml
  self:
    path: config
```
